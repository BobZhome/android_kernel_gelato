## arch/arm/mach-msm/lge/Kconfig
```kconfig
config MACH_LGE
	bool

menu "LGE Device-Specific Changes"

menu "LGE Board Selection"

config MACH_MSM7X27_GELATO
	depends on ARCH_MSM7X27
	depends on !MSM_STACKED_MEMORY
	select MACH_LGE
	bool "MSM7x27 GELATO"
	help
	  Support for the LGE MSM7x27 GELATO board.
	  
# LGE_CHANGE [yt.kim@lge.com] 2011-01-11, compile for one source [START] 
config MACH_MSM7X27_GELATO_DOP
	depends on ARCH_MSM7X27
	depends on !MSM_STACKED_MEMORY
	select MACH_LGE
	bool "MSM7x27 GELATO SPRINT DOP CDMA"
	help
	  Support for the LGE MSM7x27 GELATO CDMA board.

config MACH_MSM7X27_GELATO_QWERTY
	depends on ARCH_MSM7X27
	depends on !MSM_STACKED_MEMORY
	select MACH_LGE
	bool "MSM7x27 GELATO SPRINT QWERTY CDMA"
	help
	  Support for the LGE MSM7x27 GELATO CDMA board.
endmenu

config LGE_SUPPORT_ERS
	tristate "Support LGE ERS system"
	default n
	depends on MACH_LGE
	depends on ANDROID_RAM_CONSOLE
	help
	  LGE error reporting system

config LGE_HANDLE_MODEM_CRASH
	tristate "Support LGE Modem Crash Handler"
	default n
	depends on MACH_LGE
	depends on ANDROID_RAM_CONSOLE
	help
	  LGE modem crash handler

config LGE_HANDLE_PANIC
	tristate "Support LGE Kernel Panic Handler"
	default n
	depends on MACH_LGE
	depends on ANDROID_RAM_CONSOLE
	help
	  LGE kernel panic handler

config LGE_SUPPORT_RAPI
	tristate "Support LGE RAPI"
	default n
	depends on MACH_LGE
	help
	  LGE remote api functions

config LGE_DIAG
	tristate "Support LGE diag"
	default n
	depends on MACH_LGE
	select LGE_SUPPORT_RAPI
	help
	  LGE diag

config LGE_DIAG_ATS_ETA_MTC_KEY_LOGGING
	tristate "Support LGE diag test mode"
	default n
	depends on MACH_LGE
	help
	  LGE diag test mode

config LGE_MTD_DIRECT_ACCESS
	tristate "Support LGE mtd direct access apis"
	default n
	depends on MACH_LGE
	help
	  LGE mtd direct access apis

config LGE_HEADSET
	bool


config LGE_HEADSET_2GPIO
	tristate "LGE GPIO 2 Wire detection driver using 2 GPIO"
	default n
	depends on MACH_LGE
	select LGE_HEADSET
	help
	  LGE GPIO 2 Wire detection driver by using 2 GPIO
	  
config LGE_HEADSET_ADC
	tristate "LGE GPIO 2 Wire detection driver using ADC"
	default n
	depends on MACH_LGE
	select LGE_HEADSET
	help
	  LGE GPIO 2 Wire detection driver


config LGE_SWITCH_GPIO
	tristate "LGE GPIO switch driver"
	depends on MACH_LGE
	default n
	help
	  LGE GPIO switch driver 

config LGE_PROC_COMM
	bool "LGE added proc comm"
	depends on MACH_LGE
	default n
	help
	  LGE added proc_comm

config LGE_FUEL_GAUGE
	bool "LGE fuel gauge"
	depends on MACH_LGE
	default n
	help
	  This feature support fuel gauge for msm7K hw

config LGE_UNIFIED_LED
	tristate "LGE unified LED driver"
	depends on MACH_LGE
	default n
	help
	  LGE unified LED driver

config LGE_4G_DDR
	bool "Memory Configuration - 2G/4G DDR RAM "
	depends on MACH_LGE
	default n
	help
	  This patch is used to configure type of Memory
	  Aloha Global use Hynix 4G DDR RAM

config LGE_SUPPORT_AT_CMD
	bool "Support LGE AT_CMD system"
	default n
	depends on MACH_LGE
	help
	 LGE AT_CMD Support

config LGE_ATS_UEVENT_DEVICE
	bool "Support LGE ATS uevent device"
	default n
	depends on MACH_LGE
	help
	 Choose if use ATS_UEVENT device used for sending uevent to user space

config LGE_ATS_INPUT_DEVICE
	bool "Support LGE ATS input device"
	default n
	depends on MACH_LGE
	help
	 Choose if use ATS input device used for generating input event from user space

config LGE_FBCON_INACTIVE_CONSOLE
	bool "Support LGE FBCON inactive console"
	default n
	depends on MACH_LGE
	help
	 Choose if inactive console

config LGE_PWRSINK
	bool "Support LGE Power Sink Driver"
	default n
	depends on MACH_LGE
	help
	 Choose if use Power sink driver

config LGE_PCB_VERSION
	bool "Support LGE PCB Version RAPI"
	default n 
	depends on MACH_LGE
	help
	  Choose if use PCB Version RAPI

config LGE_PCB_REV_A
	bool "Support LGE board REVISION A"
	default n
	depends on MACH_LGE
	help
	  Use PCB Version A

config LGE_PCB_REV_B
	bool "Support LGE board REVISION B"
	default n
	depends on MACH_LGE
	help
	  Use PCB Version B

config LGE_PCB_REV_C
	bool "Support LGE board REVISION C"
	default n
	depends on MACH_LGE
	help
	  Use PCB Version C

config LGE_UART
	bool "Support LGE UART"
	default n 
	depends on MACH_LGE
	help
	  Use UART
	  
menu "LGE specific patches"
	depends on MACH_LGE

config LGE_TCP_IMPROVEMENT_PATCH
	bool "tcp improvement patch for vs740"
	default n
	help
	  This patch is used to improve tcp performance of vs740 model
	  Disable tcp delayed ack for evdo networks

config LGE_UMS_WORKAROUND_PATCH
	bool "Workaround patch about USB mass storage for vs740"
	default n
	help
	  This patch is used to workaround UMS not working problem of vs740
	  Vs740 had UMS not working problem after composition switching
	  this patch prevents the binding until mass storage thread is killed

config LGE_UMS_PERFORMANCE_PATCH
	bool "Increasing UMS R/W performance patch"
	default n
	help
	  This patch is QCT's patch code for increasing UMS R/W Performance
	  It change maximum interrupt interval from 8 micro-frame to immediate

config LGE_AUDIO_HIDDEN_MENU_TEST_PATCH
	bool "LGE audio hidden menu test patch for vs740"
	default n
	help
	  LGE audio hidden menu test patch for vs740

config LGE_CAMERA_HIDDEN_MENU_TEST_PATCH
	bool "LGE camera hidden menu test patch for vs740"
	default n
	help
	  LGE camera hidden menu test patch for vs740

config LGE_YAFFS_AUTO_CHECKPOINT_PATCH
	bool "LGE yaffs auto checkpoint patch"
	default n
	help
	  set value of yaffs_auto_checkpoint to 2. this patch can decreases 
	  mount time due to scanning all blocks of yaffs partition

config LGE_BRCM_H4_LPM_SUPPORT_PATCH
	bool "LGE brcm's bluetooth lpm patch"
	default n
	help
	  Support brcm's bluetooth LPM requirement

config LGE_MMC_CLEANUP_PATCH
	bool "LGE mmc queue cleanup patch"
	default n
	help
	  This patch is added for prevent kernel panic in case of doing
	  insert/eject repeatedly. this patch are from 2.6.32 mainstream
	  kernel

config LGE_DETECT_PIF_PATCH
	bool "LGE PIF detection capability patch"
	select LGE_PROC_COMM 
	default n
	help
	  This patch is added for detection of pif cable of factory
	  If pif is once detected, that information will be passed through
	  sysfs in battery driver

config LGE_GRAM_REFRESH_PATCH
	bool "LGE gram refresh patch"
	default n
	help
	  This patch is added for gram-embedded device like mddi.
	  because, when suspend state, power of mddi is off usually,
	  gram of DDI chip has garbage data until data of gram is refreshed.
	  this can cause displaying broken screen in time of turning backlight on.
	  for preventing this problem, add refreshing routine before turning 
	  backlight on by using late resume mechanism.

config LGE_DIAG_MTC
	tristate "Support LGE diag MTC"
	default n
	depends on LGE_DIAG
	help
	  LGE diag MTC enable

config LGE_DIAG_WMC
	bool "Support LGE diag WMC"
	default n
	depends on LGE_DIAG
	help
	  LGE diag WMC enable
	  	  
config LGE_DIAG_TESTMODE
	bool "Support LGE diag TESTMODE"
	default n
	depends on LGE_DIAG
	help
	  LGE diag TESTMODE enable

config LGE_DIAG_LCDQTEST
	bool "Support LGE diag LCD Q-TEST"
	default n
	depends on LGE_DIAG
	help
	  LGE diag LCD Q-TEST enable

config LGE_DIAG_KEYPRESS
	bool "Support LGE diag KEYPRESS"
	default n
	depends on LGE_DIAG
	help
	  LGE diag LCD KEYPRESS enable

config LGE_DIAG_SCREENSHOT
	bool "Support LGE diag SCREENSHOT"
	default n
	depends on LGE_DIAG
	help
	  LGE diag LCD SCREENSHOT enable
	  
config LGE_DIAG_WIFI
	bool "Support LGE diag WIFI"
	default n
	depends on LGE_DIAG
	help
	  LGE diag LCD WIFI enable
	  
config LGE_DIAG_UDM
	bool "Support LGE diag UDM"
	default n
	depends on LGE_DIAG
	help
	  LGE diag LCD UDM enable	  	  

config LGE_DIAG_ICD
	bool "Support LGE diag ICD"
	default n
	depends on LGE_DIAG
	help
	  LGE diag LCD ICD enable

config LGE_DIAG_SRD
	bool "Support LGE diag SRD"
	default n
	depends on LGE_DIAG
	help
	  LGE diag LCD SRD enable
	  
config DEBUG_SECTION_MISMATCH
	bool "Support debug section mismatch"
	default n
	help
	  Support debug section mismatch

config NO_ERROR_ON_MISMATCH
	bool "Support no error on mismatch"
	default n
	help
	  Support no error on mismatch
endmenu
endmenu
```

## drivers/net/wireless/bcm4330/Kconfig
```kconfig
config BCM4330
	tristate "Broadcom BCM4330 wireless support"
	select WIRELESS_EXT
	---help---
	  This is a driver for the Broadcom BCM4330 wireless chip.

config BCM4330_DEBUG
	bool "Debug"
	default n
	depends on BCM4330

config LGE_BCM432X_PATCH
	bool "BCM432X Patch by LGE"
	default y
	depends on BCM4330

config BCM4330_GPIO_BT_RESET
	int "GPIO BT_RESET"
	default 123
	depends on BCM4330

# 2011-03-05, dongseok.ok, WL_RESET change to "23" [START]
config BCM4330_GPIO_WL_RESET
	int "GPIO WL_RESET"
	default 23
	depends on BCM4330
# 2011-03-05, dongseok.ok, WL_RESET change to "23" [END]

config BCM4330_GPIO_WL_WAKE
	int "GPIO WL_WAKE"
	default 122
	depends on BCM4330

# 2011-03-05, dongseok.ok, WL_REGON is not used in BCM4330 [START]
#config BCM4330_GPIO_WL_REGON
#	int "GPIO WL_REGON"
#	default 23
#	depends on BCM4330
# 2011-03-05, dongseok.ok, WL_REGON is not used in BCM4330 [END]

config BRCM_LGE_WL_HOSTWAKEUP
	bool "Support BCM4325/BCM4329/BCM4330 Host Wakeup function"
	default 94
	depends on BCM4330

# 2011-03-05, dongseok.ok, WL_HOSTWAKEUP_IOCTL change to "y" [START]
config BRCM_LGE_WL_HOSTWAKEUP_IOCTL
	bool "Use Host Wakeup ioctl function"
	default y
	depends on BCM4330 && BRCM_LGE_WL_HOSTWAKEUP
# 2011-03-05, dongseok.ok, WL_HOSTWAKEUP_IOCTL change to "y" [END]

# 2011-03-05, dongseok.ok, WL_PKTFILTER change to "y" [START]
config BRCM_LGE_WL_PKTFILTER
	bool "Setting Multicat/Broadcast packet fillter."
	default y
	depends on BCM4330 && BRCM_LGE_WL_HOSTWAKEUP
# 2011-03-05, dongseok.ok, WL_PKTFILTER change to "y" [END]

# 2011-03-05, dongseok.ok, WL_ARPOFFLOAD change to "y" [START]
config BRCM_LGE_WL_ARPOFFLOAD
	bool "Use Arp offload function."
	default y
	depends on BCM4330 && BRCM_LGE_WL_HOSTWAKEUP
# 2011-03-05, dongseok.ok, WL_ARPOFFLOAD change to "y" [END]

config BRCM_GPIO_INTR
	bool "Use Broadcom Host Wakeup GPIO"
	default n
	depends on BCM4330
	---help---
	   This function is activated only if set CONFIG_HAS_EARLYSUSPEND.	

config BCM4330_GPIO_WL_HOSTWAKEUP
	int "GPIO WL_HOSTWAKEUP"
	default 94
	depends on BCM4330

config BRCM_USE_DEEPSLEEP
	bool "Use deepsleep instead of dhd_dev_reset"
	default n
	depends on BCM4330
	---help---
	  Use deepsleep instead of dhd_dev_reset and controlling GPIO when driver start or stop.

# 2011-03-05, dongseok.ok, BRCM_USE_SOFTAP change to "y" [START]
config BRCM_USE_SOFTAP
	bool "Use SoftAP"
	default y
	depends on BCM4330
	---help---
	Using Softap feature.
# 2011-03-05, dongseok.ok, BRCM_USE_SOFTAP change to "y" [END]

# 2011-03-05, dongseok.ok, BRCM_USE_STATIC_BUF change to "y" [START]
config BRCM_USE_STATIC_BUF
	bool "Use static buff of osl_malloc"
	default y
	depends on BCM4330
# 2011-03-05, dongseok.ok, BRCM_USE_STATIC_BUF change to "y" [END]
#LGE_CHANGE_S, 2011-0226, add CCX
config BCM43xx_CCX
    bool "Enable CCX feature"
    default n
    depends on BCM4330
    ---help---
        Enabling/disabling CCX features
#LGE_CHANGE_E, 2011-0226, add CCX

config BRCM_USE_WLP2P
	bool "Use P2P"
	default n
	depends on BCM4330
	---help---
	Using P2P feature.

config BRCM_USE_WLBTAMP
	bool "Use BTAMP"
	default n
	depends on BCM4330
	---help---
	Using BTAMP feature.
```
